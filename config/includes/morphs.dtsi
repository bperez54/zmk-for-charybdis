/{
    behaviors {
        bspc_del: backspace_delete {
                        compatible = "zmk,behavior-mod-morph";
                        #binding-cells = <0>;
                        bindings = <&kp BACKSPACE>, <&kp DELETE>;
                        mods = <(MOD_LSFT|MOD_RSFT)>;
                        keep-mods = <(MOD_RSFT)>;
        };
    };
};